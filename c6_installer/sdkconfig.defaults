## c6_updater/sdkconfig.defaults
```kconfig
CONFIG_IDF_TARGET="esp32c6"
CONFIG_ESPTOOLPY_FLASHSIZE_4MB=y
CONFIG_PARTITION_TABLE_CUSTOM=y
CONFIG_PARTITION_TABLE_CUSTOM_FILENAME="../common/c6_board/partitions_c6.csv"
CONFIG_PARTITION_TABLE_FILENAME="../common/c6_board/partitions_c6.csv"
CONFIG_PARTITION_TABLE_OFFSET=0x8000
CONFIG_BOOTLOADER_APP_TEST=y
CONFIG_BOOTLOADER_NUM_PIN_APP_TEST=2
CONFIG_BOOTLOADER_APP_TEST_PIN_LOW=y
CONFIG_BOOTLOADER_HOLD_TIME_GPIO=0
CONFIG_ESP_CONSOLE_UART_DEFAULT=y
```
